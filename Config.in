## package/hello-world/Config.in
```kconfig
config BR2_PACKAGE_HELLO_WORLD
	bool "hello_world"
	help
	  This is an example of the Hello-World package in 
	  BuildRoot-Wrapper Repository. Add all your custom packages in
	  this file tree following the normal builroot config
```
